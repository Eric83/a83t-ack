## linux-3.4/drivers/input/touchscreen/icn85xx/Kconfig
```kconfig
#
#  Touchscreen driver configuration
#

config  TOUCHSCREEN_ICN85XX_TS
       tristate  "icn85xx touchscreen driver"      
       depends on INPUT && I2C
       default y
       help
         icn83xx touchscreen driver    
```
